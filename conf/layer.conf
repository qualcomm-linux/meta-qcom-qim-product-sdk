## conf/layer.conf
```bitbake
BBFILES += "${LAYERDIR}/recipes-*/*/*.bb \
            ${LAYERDIR}/recipes-*/*/*.bbappend"
CONFDIR := "${@os.path.dirname(d.getVar('FILE', 1))}"
BBPATH .= ":${LAYERDIR}"
BBFILE_COLLECTIONS += "qti-qim-product-sdk"
BBFILE_PATTERN_qti-qim-product-sdk := "^${LAYERDIR}/"
BBFILE_PRIORITY_qti-qim-product-sdk = "7"
LAYERSERIES_COMPAT_qti-qim-product-sdk = "kirkstone scarthgap walnascar whinlatter"

# do not error out on bbappends for missing recipes
BB_DANGLINGAPPENDS_WARNONLY = "true"

PACKAGECONFIG-pn_tensorflow-lite = "gpu"
PREFERRED_VERSION_tensorflow-lite:qcom-custom-bsp ??= "2.16.1.qcom"

# add packagegroup-qcom-qim-product to the base image
CORE_IMAGE_EXTRA_INSTALL:append:qcom-custom-bsp = " packagegroup-qcom-qim-product"
ENABLE_GST_SAMPLE_APPS ??= "1"
ENABLE_GST_SAMPLE_APPS_CAMERA ??= "${ENABLE_GST_SAMPLE_APPS}"
```
